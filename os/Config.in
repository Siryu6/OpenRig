## os/Config.in
```kconfig
source "$BR2_EXTERNAL_PEDALBOARD_PATH/package/pedalboard/Config.in"
source "$BR2_EXTERNAL_PEDALBOARD_PATH/package/rpi-tryboot/Config.in"
```

## os/configs/pedalboard_rpi5_defconfig
```kconfig
BR2_aarch64=y
BR2_cortex_a76=y
BR2_TOOLCHAIN_EXTERNAL=y
BR2_TOOLCHAIN_EXTERNAL_BOOTLIN=y
BR2_TOOLCHAIN_EXTERNAL_BOOTLIN_AARCH64_GLIBC_STABLE=y
BR2_GLOBAL_PATCH_DIR="board/raspberrypi/patches $(BR2_EXTERNAL_PEDALBOARD_PATH)/board/rpi5/patches"
BR2_DOWNLOAD_FORCE_CHECK_HASHES=y
BR2_OPTIMIZE_2=y
BR2_TARGET_GENERIC_HOSTNAME="pedalboard"
BR2_TARGET_GENERIC_ISSUE="Pedalboard OS"
BR2_ROOTFS_DEVICE_CREATION_DYNAMIC_EUDEV=y
# BR2_TARGET_ENABLE_ROOT_LOGIN is not set
# BR2_TARGET_GENERIC_GETTY is not set
# BR2_TARGET_GENERIC_REMOUNT_ROOTFS_RW is not set
BR2_ROOTFS_USERS_TABLES="$(BR2_EXTERNAL_PEDALBOARD_PATH)/board/common/users.table"
BR2_ROOTFS_OVERLAY="$(BR2_EXTERNAL_PEDALBOARD_PATH)/board/common/rootfs-overlay $(BR2_EXTERNAL_PEDALBOARD_PATH)/board/rpi5/rootfs-overlay"
BR2_ROOTFS_POST_BUILD_SCRIPT="$(BR2_EXTERNAL_PEDALBOARD_PATH)/board/common/post-build.sh"
BR2_ROOTFS_POST_IMAGE_SCRIPT="$(BR2_EXTERNAL_PEDALBOARD_PATH)/board/rpi5/post-image.sh"
BR2_LINUX_KERNEL=y
BR2_LINUX_KERNEL_CUSTOM_TARBALL=y
BR2_LINUX_KERNEL_CUSTOM_TARBALL_LOCATION="$(call github,raspberrypi,linux,21b410140c47ffab5668399f6f143c7d7b935c8b)/linux-21b410140c47ffab5668399f6f143c7d7b935c8b.tar.gz"
BR2_LINUX_KERNEL_DEFCONFIG="bcm2712"
BR2_LINUX_KERNEL_CONFIG_FRAGMENT_FILES="board/raspberrypi/linux-4k-page-size.fragment $(BR2_EXTERNAL_PEDALBOARD_PATH)/board/common/linux-rt.fragment $(BR2_EXTERNAL_PEDALBOARD_PATH)/board/rpi5/linux.fragment"
BR2_LINUX_KERNEL_DTS_SUPPORT=y
BR2_LINUX_KERNEL_INTREE_DTS_NAME="broadcom/bcm2712-rpi-5-b broadcom/bcm2712d0-rpi-5-b broadcom/bcm2712-rpi-500"
BR2_LINUX_KERNEL_NEEDS_HOST_OPENSSL=y
BR2_PACKAGE_BUSYBOX_SHOW_OTHERS=y
BR2_PACKAGE_ALSA_UTILS=y
BR2_PACKAGE_ALSA_UTILS_ALSACTL=y
BR2_PACKAGE_ALSA_UTILS_AMIXER=y
BR2_PACKAGE_ALSA_UTILS_APLAY=y
BR2_PACKAGE_ALSA_UTILS_SPEAKER_TEST=y
BR2_PACKAGE_JACK2=y
BR2_PACKAGE_DEJAVU=y
BR2_PACKAGE_MESA3D=y
BR2_PACKAGE_MESA3D_GALLIUM_DRIVER_V3D=y
BR2_PACKAGE_MESA3D_GBM=y
BR2_PACKAGE_MESA3D_OPENGL_EGL=y
BR2_PACKAGE_MESA3D_OPENGL_ES=y
BR2_PACKAGE_E2FSPROGS=y
BR2_PACKAGE_BRCMFMAC_SDIO_FIRMWARE_RPI=y
BR2_PACKAGE_BRCMFMAC_SDIO_FIRMWARE_RPI_WIFI=y
BR2_PACKAGE_RPI_FIRMWARE=y
BR2_PACKAGE_RPI_FIRMWARE_CONFIG_FILE="$(BR2_EXTERNAL_PEDALBOARD_PATH)/board/rpi5/config.txt"
BR2_PACKAGE_RPI_FIRMWARE_CMDLINE_FILE="$(BR2_EXTERNAL_PEDALBOARD_PATH)/board/rpi5/cmdline.txt"
BR2_PACKAGE_KMOD=y
BR2_PACKAGE_KMOD_TOOLS=y
BR2_PACKAGE_LIBINPUT=y
BR2_PACKAGE_LILV=y
BR2_PACKAGE_CA_CERTIFICATES=y
BR2_PACKAGE_CHRONY=y
BR2_PACKAGE_DROPBEAR=y
BR2_PACKAGE_IW=y
BR2_PACKAGE_NETWORK_MANAGER=y
BR2_PACKAGE_NETWORK_MANAGER_CLI=y
BR2_PACKAGE_WIRELESS_REGDB=y
BR2_PACKAGE_WPA_SUPPLICANT=y
BR2_PACKAGE_WPA_SUPPLICANT_DBUS=y
BR2_PACKAGE_UTIL_LINUX=y
BR2_PACKAGE_UTIL_LINUX_BINARIES=y
BR2_PACKAGE_UTIL_LINUX_PARTX=y
BR2_PACKAGE_UTIL_LINUX_SETPRIV=y
BR2_PACKAGE_RAUC=y
BR2_PACKAGE_RAUC_JSON=y
BR2_TARGET_ROOTFS_EXT2=y
BR2_TARGET_ROOTFS_EXT2_4=y
BR2_TARGET_ROOTFS_EXT2_LABEL="rootfs"
BR2_TARGET_ROOTFS_EXT2_SIZE="512M"
# BR2_TARGET_ROOTFS_TAR is not set
BR2_PACKAGE_HOST_DOSFSTOOLS=y
BR2_PACKAGE_HOST_GENIMAGE=y
BR2_PACKAGE_HOST_KMOD_XZ=y
BR2_PACKAGE_HOST_MTOOLS=y
BR2_PACKAGE_HOST_RAUC=y
BR2_PACKAGE_PEDALBOARD=y
BR2_PACKAGE_PEDALBOARD_GPIO=y
BR2_PACKAGE_RPI_TRYBOOT=y
```

## os/configs/pedalboard_x86_64_defconfig
```kconfig
BR2_x86_64=y
BR2_x86_x86_64_v2=y
BR2_TOOLCHAIN_EXTERNAL=y
BR2_TOOLCHAIN_EXTERNAL_BOOTLIN=y
BR2_TOOLCHAIN_EXTERNAL_BOOTLIN_X86_64_V2_GLIBC_STABLE=y
BR2_GLOBAL_PATCH_DIR="board/pc/patches $(BR2_EXTERNAL_PEDALBOARD_PATH)/board/x86_64/patches"
BR2_DOWNLOAD_FORCE_CHECK_HASHES=y
BR2_OPTIMIZE_2=y
BR2_TARGET_GENERIC_HOSTNAME="pedalboard"
BR2_TARGET_GENERIC_ISSUE="Pedalboard OS"
BR2_ROOTFS_DEVICE_CREATION_DYNAMIC_EUDEV=y
# BR2_TARGET_ENABLE_ROOT_LOGIN is not set
# BR2_TARGET_GENERIC_GETTY is not set
# BR2_TARGET_GENERIC_REMOUNT_ROOTFS_RW is not set
BR2_ROOTFS_USERS_TABLES="$(BR2_EXTERNAL_PEDALBOARD_PATH)/board/common/users.table"
BR2_ROOTFS_OVERLAY="$(BR2_EXTERNAL_PEDALBOARD_PATH)/board/common/rootfs-overlay $(BR2_EXTERNAL_PEDALBOARD_PATH)/board/x86_64/rootfs-overlay"
BR2_ROOTFS_POST_BUILD_SCRIPT="$(BR2_EXTERNAL_PEDALBOARD_PATH)/board/common/post-build.sh $(BR2_EXTERNAL_PEDALBOARD_PATH)/board/x86_64/post-build.sh"
BR2_ROOTFS_POST_IMAGE_SCRIPT="$(BR2_EXTERNAL_PEDALBOARD_PATH)/board/x86_64/post-image.sh"
BR2_LINUX_KERNEL=y
BR2_LINUX_KERNEL_CUSTOM_VERSION=y
BR2_LINUX_KERNEL_CUSTOM_VERSION_VALUE="6.18.60"
BR2_LINUX_KERNEL_USE_ARCH_DEFAULT_CONFIG=y
BR2_LINUX_KERNEL_CONFIG_FRAGMENT_FILES="$(BR2_EXTERNAL_PEDALBOARD_PATH)/board/common/linux-rt.fragment $(BR2_EXTERNAL_PEDALBOARD_PATH)/board/x86_64/linux.fragment"
BR2_LINUX_KERNEL_NEEDS_HOST_OPENSSL=y
BR2_LINUX_KERNEL_NEEDS_HOST_LIBELF=y
# In the system slot, so updates replace it: GRUB loads it from there
BR2_LINUX_KERNEL_INSTALL_TARGET=y
BR2_PACKAGE_BUSYBOX_SHOW_OTHERS=y
BR2_PACKAGE_ALSA_UTILS=y
BR2_PACKAGE_ALSA_UTILS_ALSACTL=y
BR2_PACKAGE_ALSA_UTILS_AMIXER=y
BR2_PACKAGE_ALSA_UTILS_APLAY=y
BR2_PACKAGE_ALSA_UTILS_SPEAKER_TEST=y
BR2_PACKAGE_JACK2=y
BR2_PACKAGE_DEJAVU=y
BR2_PACKAGE_MESA3D=y
# iris (Intel Gen8+, e.g. N100) and llvmpipe need LLVM
BR2_PACKAGE_MESA3D_LLVM=y
BR2_PACKAGE_MESA3D_GALLIUM_DRIVER_CROCUS=y
BR2_PACKAGE_MESA3D_GALLIUM_DRIVER_IRIS=y
BR2_PACKAGE_MESA3D_GALLIUM_DRIVER_LLVMPIPE=y
BR2_PACKAGE_MESA3D_GALLIUM_DRIVER_VIRGL=y
BR2_PACKAGE_MESA3D_GBM=y
BR2_PACKAGE_MESA3D_OPENGL_EGL=y
BR2_PACKAGE_MESA3D_OPENGL_ES=y
BR2_PACKAGE_E2FSPROGS=y
BR2_PACKAGE_LINUX_FIRMWARE=y
BR2_PACKAGE_LINUX_FIRMWARE_I915=y
BR2_PACKAGE_LINUX_FIRMWARE_IWLWIFI_9XXX=y
BR2_PACKAGE_LINUX_FIRMWARE_IWLWIFI_22000=y
BR2_PACKAGE_LINUX_FIRMWARE_IWLWIFI_QUZ=y
BR2_PACKAGE_LINUX_FIRMWARE_IWLWIFI_6E=y
BR2_PACKAGE_LINUX_FIRMWARE_RTL_8169=y
BR2_PACKAGE_LINUX_FIRMWARE_RTL_88XX=y
BR2_PACKAGE_KMOD=y
BR2_PACKAGE_KMOD_TOOLS=y
BR2_PACKAGE_LIBINPUT=y
BR2_PACKAGE_LILV=y
BR2_PACKAGE_CA_CERTIFICATES=y
BR2_PACKAGE_CHRONY=y
BR2_PACKAGE_DROPBEAR=y
BR2_PACKAGE_IW=y
BR2_PACKAGE_NETWORK_MANAGER=y
BR2_PACKAGE_NETWORK_MANAGER_CLI=y
BR2_PACKAGE_WIRELESS_REGDB=y
BR2_PACKAGE_WPA_SUPPLICANT=y
BR2_PACKAGE_WPA_SUPPLICANT_DBUS=y
BR2_PACKAGE_UTIL_LINUX=y
BR2_PACKAGE_UTIL_LINUX_BINARIES=y
BR2_PACKAGE_UTIL_LINUX_PARTX=y
BR2_PACKAGE_UTIL_LINUX_SETPRIV=y
BR2_PACKAGE_RAUC=y
BR2_PACKAGE_RAUC_JSON=y
BR2_TARGET_ROOTFS_EXT2=y
BR2_TARGET_ROOTFS_EXT2_4=y
BR2_TARGET_ROOTFS_EXT2_LABEL="rootfs"
BR2_TARGET_ROOTFS_EXT2_SIZE="512M"
# BR2_TARGET_ROOTFS_TAR is not set
BR2_TARGET_GRUB2=y
BR2_TARGET_GRUB2_X86_64_EFI=y
# Boot slots (grub.cfg): environment block, tests, disk of the EFI partition
BR2_TARGET_GRUB2_BUILTIN_MODULES_EFI="boot linux ext2 fat part_gpt normal efi_gop loadenv test regexp echo"
BR2_PACKAGE_HOST_DOSFSTOOLS=y
BR2_PACKAGE_HOST_GENIMAGE=y
BR2_PACKAGE_HOST_MTOOLS=y
BR2_PACKAGE_HOST_RAUC=y
BR2_PACKAGE_PEDALBOARD=y
```

## os/package/pedalboard/Config.in
```kconfig
config BR2_PACKAGE_PEDALBOARD
	bool "pedalboard"
	depends on BR2_PACKAGE_HOST_RUSTC_TARGET_ARCH_SUPPORTS
	depends on BR2_INSTALL_LIBSTDCPP # jack2, NeuralAudio
	depends on BR2_TOOLCHAIN_GCC_AT_LEAST_10 # C++20 (NeuralAudio)
	depends on BR2_PACKAGE_HAS_UDEV # libinput
	select BR2_PACKAGE_HOST_RUSTC
	select BR2_PACKAGE_ALSA_LIB
	select BR2_PACKAGE_ALSA_LIB_SEQ # MIDI input
	select BR2_PACKAGE_JACK2
	select BR2_PACKAGE_LILV
	select BR2_PACKAGE_LIBINPUT
	select BR2_PACKAGE_LIBXKBCOMMON
	select BR2_PACKAGE_LIBDRM
	select BR2_PACKAGE_FONTCONFIG # loaded at run time by the UI
	select BR2_PACKAGE_DEJAVU
	select BR2_PACKAGE_CA_CERTIFICATES # TONE3000 over HTTPS
	help
	  Guitar pedalboard: LV2 host, NAM / IR blocks, touch UI drawn
	  straight on the display (DRM/KMS), on a JACK server.

	  Needs an OpenGL ES / EGL / GBM provider (mesa3d) at run time.

if BR2_PACKAGE_PEDALBOARD

config BR2_PACKAGE_PEDALBOARD_GPIO
	bool "footswitches and encoder on GPIO"
	depends on BR2_aarch64
	help
	  Footswitches and rotary encoder on the Raspberry Pi GPIO.

endif

comment "pedalboard needs a toolchain w/ C++, gcc >= 10, udev and a Rust target"
	depends on !BR2_PACKAGE_HOST_RUSTC_TARGET_ARCH_SUPPORTS || \
		!BR2_INSTALL_LIBSTDCPP || !BR2_TOOLCHAIN_GCC_AT_LEAST_10 || \
		!BR2_PACKAGE_HAS_UDEV
```

## os/package/rpi-tryboot/Config.in
```kconfig
config BR2_PACKAGE_RPI_TRYBOOT
	bool "rpi-tryboot"
	depends on BR2_aarch64 || BR2_arm
	help
	  Set the Raspberry Pi firmware's one-shot "tryboot" flag, so
	  the next reboot starts the [tryboot] partition of
	  autoboot.txt once (system updates).
```

## os/package/rtpmidid/Config.in
```kconfig
config BR2_PACKAGE_RTPMIDID
	bool "rtpmidid"
	depends on BR2_INSTALL_LIBSTDCPP
	depends on BR2_TOOLCHAIN_GCC_AT_LEAST_13 # C++20 <format>
	depends on BR2_USE_MMU # dbus
	depends on BR2_TOOLCHAIN_HAS_THREADS # dbus
	select BR2_PACKAGE_ALSA_LIB
	select BR2_PACKAGE_ALSA_LIB_SEQ
	select BR2_PACKAGE_AVAHI
	select BR2_PACKAGE_AVAHI_DAEMON
	select BR2_PACKAGE_DBUS # libavahi-client
	help
	  RTP-MIDI (AppleMIDI) daemon: each network MIDI session
	  becomes an ALSA sequencer port. Sessions are announced with
	  mDNS / DNS-SD through avahi-daemon.

	  Network MIDI of the pedalboard OS (docs/MIDI.md), started by
	  /usr/libexec/pedalboard/network-midi when it is switched on.

	  https://github.com/davidmoreno/rtpmidid

comment "rtpmidid needs a toolchain w/ C++, threads, gcc >= 13"
	depends on BR2_USE_MMU
	depends on !BR2_INSTALL_LIBSTDCPP || \
		!BR2_TOOLCHAIN_GCC_AT_LEAST_13 || !BR2_TOOLCHAIN_HAS_THREADS
```
